/* linker.ld */
/* This script tells the linker how to combine object files
   and where to place sections in memory. */

ENTRY(_start) /* Define the entry point symbol (from kernel.asm) */
OUTPUT_FORMAT(binary) /* Output a raw binary file */

SECTIONS
{
    /* The kernel code and data will be placed starting at address 0x1000.
       This matches the address where the bootloader loads the kernel. */
    . = 0x1000;

    /* Place the text (code) section */
    .text :
    {
        *(.text) /* Include all .text sections from input object files */
    }

    /* Place the data section */
    .data :
    {
        *(.data) /* Include all .data sections from input object files */
    }

    /* Place the BSS (Block Started by Symbol) section for uninitialized data */
    .bss :
    {
        *(.bss) /* Include all .bss sections from input object files */
    }

    /* Discard unwanted sections generated by the compiler/assembler */
    /DISCARD/ :
    {
        *(.comment)
        *(.eh_frame)
        *(.note.GNU-stack) /* Discard GNU_stack note if present */
    }
}
